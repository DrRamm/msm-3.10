/* Copyright (c) 2012-2013, The Linux Foundation. All rights reserved.
 *
 * This program is free software; you can redistribute it and/or modify
 * it under the terms of the GNU General Public License version 2 and
 * only version 2 as published by the Free Software Foundation.
 *
 * This program is distributed in the hope that it will be useful,
 * but WITHOUT ANY WARRANTY; without even the implied warranty of
 * MERCHANTABILITY or FITNESS FOR A PARTICULAR PURPOSE.  See the
 * GNU General Public License for more details.
 */

/*---------------------------------------------------------------------------
 * This file is autogenerated file using gcdb parser. Please do not edit it.
 * Update input XML file to add a new entry or update variable in this file
 * VERSION = "1.0"
 *---------------------------------------------------------------------------*/
&soc {
	dsi_sharp_fhd_cmd: qcom,mdss_dsi_sharp_fhd_cmd {
		compatible = "qcom,mdss-dsi-panel";
		status = "okay";
		qcom,mdss-dsi-panel-name = "sharp fhd cmd mode dsi panel";
		qcom,mdss-dsi-panel-id = <3>;
		qcom,mdss-dsi-panel-controller = <&mdss_dsi0>;
		qcom,mdss-dsi-panel-type = "dsi_cmd_mode";
		qcom,mdss-dsi-panel-destination = "display_1";
		qcom,mdss-dsi-panel-framerate = <60>;
		qcom,mdss-dsi-virtual-channel-id = <0>;
		qcom,mdss-dsi-stream = <0>;
		qcom,mdss-dsi-panel-width = <1080>;
		qcom,mdss-dsi-panel-height = <1920>;
		qcom,mdss-dsi-h-front-porch = <80>;
		qcom,mdss-dsi-h-back-porch = <40>;
		qcom,mdss-dsi-h-pulse-width = <10>;
		qcom,mdss-dsi-h-sync-skew = <0>;
		qcom,mdss-dsi-v-back-porch = <4>;
		qcom,mdss-dsi-v-front-porch = <4>;
		qcom,mdss-dsi-v-pulse-width = <2>;
		qcom,mdss-dsi-h-left-border = <0>;
		qcom,mdss-dsi-h-right-border = <0>;
		qcom,mdss-dsi-v-top-border = <0>;
		qcom,mdss-dsi-v-bottom-border = <0>;
		qcom,mdss-dsi-bpp = <24>;
		qcom,mdss-dsi-color-order = <0>;
		qcom,mdss-dsi-underflow-color = <0xff>;
		qcom,mdss-dsi-border-color = <0>;
		qcom,mdss-dsi-on-command = [
			15 01 00 00 01 00 02 FF 10
			15 01 00 00 01 00 02 BB 10
			15 01 00 00 01 00 02 B0 03

			15 00 00 00 01 00 02 FF 24
			15 00 00 00 01 00 02 C4 69
			15 00 00 00 01 00 02 C9 00
			15 01 00 00 01 00 02 FB 01

			15 01 00 00 01 00 02 FF 22
			15 01 00 00 01 00 02 FB 01
			15 01 00 00 01 00 02 00 28
			15 01 00 00 01 00 02 01 2C
			15 01 00 00 01 00 02 02 30
			15 01 00 00 01 00 02 03 34
			15 01 00 00 01 00 02 04 38
			15 01 00 00 01 00 02 05 3C
			15 01 00 00 01 00 02 06 40
			15 01 00 00 01 00 02 07 48
			15 01 00 00 01 00 02 08 4C
			15 01 00 00 01 00 02 09 50
			15 01 00 00 01 00 02 0A 58
			15 01 00 00 01 00 02 0B 60
			15 01 00 00 01 00 02 0C 60
			15 01 00 00 01 00 02 0D 58
			15 01 00 00 01 00 02 0E 50
			15 01 00 00 01 00 02 0F 48
			15 01 00 00 01 00 02 10 38
			15 01 00 00 01 00 02 11 28
			15 01 00 00 01 00 02 12 28
			15 01 00 00 01 00 02 13 28
			15 01 00 00 01 00 02 1B 00
			15 01 00 00 01 00 02 1C 00
			15 01 00 00 01 00 02 1D 00
			15 01 00 00 01 00 02 1E 00
			15 01 00 00 01 00 02 1F 00
			15 01 00 00 01 00 02 20 00
			15 01 00 00 01 00 02 21 00
			15 01 00 00 01 00 02 22 00
			15 01 00 00 01 00 02 23 00
			15 01 00 00 01 00 02 24 00
			15 01 00 00 01 00 02 25 00
			15 01 00 00 01 00 02 26 00
			15 01 00 00 01 00 02 27 00
			15 01 00 00 01 00 02 28 00
			15 01 00 00 01 00 02 29 00
			15 01 00 00 01 00 02 2A 00
			15 01 00 00 01 00 02 2B 00
			15 01 00 00 01 00 02 2F 00
			15 01 00 00 01 00 02 30 00
			15 01 00 00 01 00 02 31 00
			15 01 00 00 01 00 02 32 80
			15 01 00 00 01 00 02 33 80
			15 01 00 00 01 00 02 34 80
			15 01 00 00 01 00 02 35 82
			15 01 00 00 01 00 02 36 84
			15 01 00 00 01 00 02 37 86
			15 01 00 00 01 00 02 38 88
			15 01 00 00 01 00 02 39 8A
			15 01 00 00 01 00 02 3A 8C
			15 01 00 00 01 00 02 3B 8E
			15 01 00 00 01 00 02 3F 90
			15 01 00 00 01 00 02 40 92
			15 01 00 00 01 00 02 41 94
			15 01 00 00 01 00 02 42 94
			15 01 00 00 01 00 02 43 92
			15 01 00 00 01 00 02 44 90
			15 01 00 00 01 00 02 45 8E
			15 01 00 00 01 00 02 46 8C
			15 01 00 00 01 00 02 47 8A
			15 01 00 00 01 00 02 48 88
			15 01 00 00 01 00 02 49 86
			15 01 00 00 01 00 02 4A 84
			15 01 00 00 01 00 02 4B 82
			15 01 00 00 01 00 02 4C 80
			15 01 00 00 01 00 02 4D 08
			15 01 00 00 01 00 02 1A 00
			15 01 00 00 01 00 02 53 01
			15 01 00 00 01 00 02 54 01
			15 01 00 00 01 00 02 56 00
			15 01 00 00 01 00 02 64 2F
			15 01 00 00 01 00 02 68 00

			15 01 00 00 01 00 02 FF 10
			15 01 00 00 01 00 02 35 00
			05 01 00 00 78 00 02 11 00
			15 01 00 00 01 00 02 51 ff
			15 01 00 00 01 00 02 53 2c
			15 01 00 00 01 00 02 55 80
			15 01 00 00 01 00 02 FF F0
			15 01 00 00 01 00 02 92 01
			15 01 00 00 01 00 02 13 01
			15 01 00 00 01 00 02 FF 10
			05 01 00 00 28 00 02 29 00
			];
		qcom,mdss-dsi-off-command = [
			15 01 00 00 00 00 02 FF 10
			39 01 00 00 11 00 02 28 00
			39 01 00 00 44 00 02 10 00
			];
		qcom,mdss-dsi-on-command-state = "dsi_lp_mode";
		qcom,mdss-dsi-off-command-state = "dsi_hs_mode";
		qcom,mdss-dsi-h-sync-pulse = <0>;
		qcom,mdss-dsi-traffic-mode = <1>;
		qcom,mdss-dsi-lane-map = <0>;
		qcom,mdss-dsi-bllp-eof-power-mode;
		qcom,mdss-dsi-bllp-power-mode;
		qcom,mdss-dsi-lane-0-state;
		qcom,mdss-dsi-lane-1-state;
		qcom,mdss-dsi-lane-2-state;
		qcom,mdss-dsi-lane-3-state;
		qcom,mdss-dsi-te-pin-select = <1>;
		qcom,mdss-dsi-te-v-sync-rd-ptr-irq-line = <0x2c>;
		qcom,mdss-dsi-te-v-sync-continues-lines = <0x3c>;
		qcom,mdss-dsi-te-dcs-command = <1>;
		qcom,mdss-dsi-te-check-enable;
		qcom,mdss-dsi-te-using-te-pin;
		qcom,mdss-dsi-panel-timings = [e3 50 36 00 a9 a3 3a 50 3d 03 04 00];
		qcom,mdss-dsi-t-clk-post = <0x20>;
		qcom,mdss-dsi-t-clk-pre = <0x36>;
		qcom,mdss-dsi-bl-min-level = <1>;
		qcom,mdss-dsi-bl-max-level = <4095>;
		qcom,mdss-dsi-dma-trigger = <0x04>;
		qcom,mdss-dsi-mdp-trigger = <0x0>;
		qcom,mdss-dsi-bl-pmic-control-type = "bl_ctrl_wled";
		qcom,mdss-dsi-reset-sequence = <1 20>, <0 20>, <1 20>;
		qcom,mdss-pan-physical-width-dimension = <61>;
		qcom,mdss-pan-physical-height-dimension = <109>;
		qcom,dispparam-enabled;
			qcom,mdss-dsi-dispparam-ceon-command = [39 01 00 00 21 00 02 00 00 29 01 00 00 00 00 02 b0 04 29 01 00 00 00 00 02 d6 01 29 01 00 00 00 00 02 ca 01 29 01 00 00 00 00 02 b0 03];
			qcom,mdss-dsi-dispparam-ceon-command-state = "dsi_hs_mode";
			qcom,mdss-dsi-dispparam-ceoff-command = [39 01 00 00 21 00 02 00 00 29 01 00 00 00 00 02 b0 04 29 01 00 00 00 00 02 d6 01 29 01 00 00 00 00 02 ca 00 29 01 00 00 00 00 02 b0 03];
			qcom,mdss-dsi-dispparam-ceoff-command-state = "dsi_hs_mode";
			qcom,mdss-dsi-dispparam-cabcon-command = [39 01 00 00 00 00 02 55 01];
			qcom,mdss-dsi-dispparam-cabcon-command-state = "dsi_hs_mode";
			qcom,mdss-dsi-dispparam-cabcoff-command = [39 01 00 00 00 00 02 55 00];
			qcom,mdss-dsi-dispparam-cabcoff-command-state = "dsi_hs_mode";
			qcom,mdss-dsi-dispparam-warm-command = [39 01 00 00 21 00 02 00 00 29 01 00 00 00 00 02 b0 04 29 01 00 00 00 00 02 d6 01 29 01 00 00 00 00 1b d3 1b 33 bb cc 80 33 33 33 00 01 00 a0 d8 a0 00 47 33 33 22 70 02 47 53 3d bf 02 29 01 00 00 00 00 19 c7 01 0d 17 21 31 4e 42 52 60 69 72 77 17 21 29 31 3d 4e 40 56 62 69 72 77 29 01 00 00 00 00 19 c8 13 1a 20 27 34 4f 42 52 60 69 72 77 29 2e 32 37 40 4f 40 56 62 69 72 77 29 01 00 00 00 00 19 c9 27 2b 2e 33 3d 53 44 55 60 69 72 77 3d 3f 40 43 49 53 42 59 62 69 72 77 29 01 00 00 00 00 02 b0 03];
			qcom,mdss-dsi-dispparam-warm-command-state = "dsi_hs_mode";
			qcom,mdss-dsi-dispparam-default-command = [29 01 00 00 00 00 02 b0 04 29 01 00 00 00 00 02 d6 01 29 01 00 00 00 00 1b d3 1b 33 bb cc 80 33 33 33 00 01 00 a0 d8 a0 00 47 33 33 22 70 02 47 53 3d bf 02 29 01 00 00 00 00 19 c7 01 0d 17 21 31 4e 42 52 60 69 72 77 17 21 29 31 3d 4e 40 56 62 69 72 77 29 01 00 00 00 00 19 c8 01 0d 17 21 31 4e 42 52 60 69 72 77 17 21 29 31 3d 4e 40 56 62 69 72 77 29 01 00 00 00 00 19 c9 01 0d 17 21 31 4e 42 52 60 69 72 77 17 21 29 31 3d 4e 40 56 62 69 72 77 29 01 00 00 00 00 02 b0 03];
			qcom,mdss-dsi-dispparam-default-command-state = "dsi_hs_mode";
			qcom,mdss-dsi-dispparam-cold-command = [39 01 00 00 21 00 02 00 00 29 01 00 00 00 00 02 b0 04 29 01 00 00 00 00 02 d6 01 29 01 00 00 00 00 1b d3 1b 33 bb cc 80 33 33 33 00 01 00 a0 d8 a0 00 47 33 33 22 70 02 47 53 3d bf 02 29 01 00 00 00 00 19 c7 17 1d 22 29 36 50 43 52 60 69 72 77 2d 31 34 39 42 50 41 56 62 69 72 77 29 01 00 00 00 00 19 c8 11 18 1e 26 33 4f 42 52 60 69 72 77 27 2c 30 36 3f 4f 40 56 62 69 72 77 29 01 00 00 00 00 19 c9 01 0d 17 21 31 4e 42 52 60 69 72 77 17 21 29 31 3d 4e 40 56 62 69 72 77 29 01 00 00 00 00 02 b0 03];
			qcom,mdss-dsi-dispparam-cold-command-state = "dsi_hs_mode";
	};
};
